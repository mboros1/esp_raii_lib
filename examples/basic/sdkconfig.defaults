## examples/timer_example/sdkconfig.defaults
```kconfig
# Minimal configuration for timer example
CONFIG_ESPTOOLPY_FLASHSIZE_2MB=y

# Enable timer debugging (optional)
CONFIG_ESP_TIMER_PROFILING=n
```

## test_app/sdkconfig.defaults
```kconfig
# Test application configuration
CONFIG_IDF_TARGET="esp32"

# Enable Unity test framework
CONFIG_UNITY_ENABLE_FIXTURE=y
CONFIG_UNITY_ENABLE_IDF_TEST_RUNNER=n

# Enable C++ exceptions for RAII
CONFIG_COMPILER_CXX_EXCEPTIONS=y
CONFIG_COMPILER_CXX_EXCEPTIONS_EMG_POOL_SIZE=0

# Enable C++ RTTI
CONFIG_COMPILER_CXX_RTTI=y

# Optimization for testing
CONFIG_COMPILER_OPTIMIZATION_SIZE=y

# Increase main task stack for tests
CONFIG_ESP_MAIN_TASK_STACK_SIZE=8192

# Timer configuration
CONFIG_ESP_TIMER_TASK_STACK_SIZE=4096

# Log output
CONFIG_LOG_DEFAULT_LEVEL_INFO=y
CONFIG_LOG_COLORS=y

# FreeRTOS
CONFIG_FREERTOS_HZ=1000
CONFIG_FREERTOS_ASSERT_ON_UNTESTED_FUNCTION=y

# For QEMU compatibility
CONFIG_ESP_SYSTEM_PANIC_PRINT_HALT=y
CONFIG_ESP_CONSOLE_UART_DEFAULT=y
CONFIG_ESP_CONSOLE_UART_BAUDRATE=115200
```
